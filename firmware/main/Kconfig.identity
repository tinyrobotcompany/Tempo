## firmware/main/Kconfig.identity
```kconfig
menu "Tempo protected identity storage"
config TEMPO_IDENTITY_HMAC_KEY_ID
    int "Factory-provisioned and locked HMAC key slot for identity storage"
    range -1 5
    default -1
    help
        -1 disables identity storage until manufacturing selects a provisioned
        HMAC_UP slot. Firmware never programs eFuses or stores unencrypted keys.
config TEMPO_DEVICE_SUFFIX
    string "Per-device DNS namespace"
    default "tempo.tinyrobotcompany.io"
config TEMPO_PRODUCTION_IDENTITY
    bool "Require hardware protection before generating device identity"
    default y
    help
        Fail closed unless Secure Boot and flash encryption are active. Factory
        eFuse provisioning is a separate controlled process. Never disable for shipping.
endmenu
```

## firmware/main/Kconfig.projbuild
```kconfig
rsource "Kconfig.identity"
# Phone positioning uses a locally distributed Apple Shortcut. No hosted URL is required.
menu "Tempo device enrollment"
config TEMPO_PRODUCTION_RELEASE
    bool "Protected production release compatibility"
    default n
    depends on SECURE_BOOT && SECURE_FLASH_ENC_ENABLED
    help
        Selects the protected-device OTA compatibility identifier. Production
        release tooling validates all hardware security and enrollment settings.
        Enabling this does not provision hardware; initial migration requires USB.
config TEMPO_ENROLLMENT_URL
    string "Production enrollment HTTPS endpoint"
    default ""
    help
        Azure certificate API URL ending in /v1/device. Empty disables the network
        worker but still initializes the device identity under the hardware guards;
        release manufacturing must set the deployed endpoint, never a laptop URL.
endmenu
```
